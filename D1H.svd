# D1H.pdf register map
Vendor: Allwinner; Series: D1H.pdf; File version: 0.1
CPU: XuanTie C906 RISC-V CPU 0, little endian, MPU, FPU, double-precision FPU, 0 interrupt priority bits
Registers are 32-bit, read-write, reset 0x0 unless marked. A register's access mark holds for its fields unless they carry their own. Offsets are from the block's base; [hi:lo] are bit positions.

## Audio_Codec (part 5 of 5)
Base 0x02030000
0x34C ADC_CUR_REG reset 0x151515
  [1:0] ADC1_OUTPUT_CURRENT_ADC1_OP_MIC2 — ADC1_OUTPUT_CURRENT ADC1 OP MIC2 Output Current Select 00: 15I 01: 20I 10: 35I 11: 40I I=7 uA 9 Interfaces ................................................................................................................................................................ 837 9.1 TWI .................................................................................................................................................................. 837 9.1.1 Overview ............................................................................................................................................. 837 9.1.2 Block Diagram ..................................................................................................................................... 837 9.1.3 Functional Description ........................................................................................................................ 839 9.1.4 Programming Guidelines ..................................................................................................................... 845 9.1.5 Register List ......................................................................................................................................... 848 9.1.6 Register Description ............................................................................................................................ 849 9.2 UART................................................................................................................................................................ 864 9.2.1 Overview ............................................................................................................................................. 864 9.2.2 Block Diagram ..................................................................................................................................... 864 9.2.3 Functional Description ........................................................................................................................ 865 9.2.4 Programming Guidelines ..................................................................................................................... 871 9.2.5 Register List ......................................................................................................................................... 874 9.2.6 Register Description ............................................................................................................................ 876 9.3 SPI .................................................................................................................................................................... 905 9.3.1 Overview ............................................................................................................................................. 905 9.3.2 Block Diagram ..................................................................................................................................... 905 9.3.3 Functional Description ........................................................................................................................ 907 9.3.4 Programming Guidelines ..................................................................................................................... 915 9.3.5 Register List ......................................................................................................................................... 918 9.3.6 Register Description ............................................................................................................................ 919 9.4 SPI_DBI ............................................................................................................................................................ 940 9.4.1 Overview ............................................................................................................................................. 940 9.4.2 Block Diagram ..................................................................................................................................... 941 9.4.3 Functional Description ........................................................................................................................ 942 9.4.4 Programming Guidelines ..................................................................................................................... 962 9.4.5 Register List ......................................................................................................................................... 970 9.4.6 Register Description ............................................................................................................................ 971 9.5 USB2.0 DRD ................................................................................................................................................... 1003 9.5.1 Overview ........................................................................................................................................... 1003 9.5.2 Block Diagram ................................................................................................................................... 1004 9.5.3 Functional Description ...................................................................................................................... 1004 9.6 USB2.0 HOST ................................................................................................................................................. 1006 9.6.1 Overview ........................................................................................................................................... 1006 9.6.2 Block Diagram ................................................................................................................................... 1006 9.6.3 Functional Description ...................................................................................................................... 1007 9.6.4 Register List ....................................................................................................................................... 1007 9.6.5 EHCI Register Description.................................................................................................................. 1009 9.6.6 OHCI Register Description ................................................................................................................. 1026 9.7 GPIO .............................................................................................................................................................. 1048 9.7.1 Overview ........................................................................................................................................... 1048 9.7.2 Block Diagram ................................................................................................................................... 1048 9.7.3 Functional Description ...................................................................................................................... 1049 9.7.4 Register List ....................................................................................................................................... 1058 9.7.5 Register Description .......................................................................................................................... 1060 9.8 GPADC ........................................................................................................................................................... 1168 9.8.1 Overview ........................................................................................................................................... 1168 9.8.2 Block Diagram ................................................................................................................................... 1168 9.8.3 Functional Description ...................................................................................................................... 1169 9.8.4 Programming Guidelines ................................................................................................................... 1170 9.8.5 Register List ....................................................................................................................................... 1172 9.8.6 Register Description .......................................................................................................................... 1173 9.9 TPADC ............................................................................................................................................................ 1182 9.9.1 Overview ........................................................................................................................................... 1182 9.9.2 Functional Description ...................................................................................................................... 1182 9.9.3 Register List ....................................................................................................................................... 1188 9.9.4 Register Description .......................................................................................................................... 1189 9.10 LRADC ............................................................................................................................................................ 1197 9.10.1 Overview ........................................................................................................................................... 1197 9.10.2 Block Diagram ................................................................................................................................... 1197 9.10.3 Functional Description ...................................................................................................................... 1198 9.10.4 Programming Guidelines ................................................................................................................... 1199 9.10.5 Register List ....................................................................................................................................... 1201 9.10.6 Register Description .......................................................................................................................... 1201 9.11 PWM ............................................................................................................................................................. 1206 9.11.1 Overview ........................................................................................................................................... 1206 9.11.2 Block Diagram ................................................................................................................................... 1206 9.11.3 Functional Description ...................................................................................................................... 1207 9.11.4 Programming Guidelines ................................................................................................................... 1217 9.11.5 Register List ....................................................................................................................................... 1218 9.11.6 Register Description .......................................................................................................................... 1220 9.12 LEDC .............................................................................................................................................................. 1247 9.12.1 Overview ........................................................................................................................................... 1247 9.12.2 Block Diagram ................................................................................................................................... 1247 9.12.3 Functional Description ...................................................................................................................... 1248 9.12.4 Programming Guidelines ................................................................................................................... 1252 9.12.5 Register List ....................................................................................................................................... 1257 9.12.6 Register Description .......................................................................................................................... 1257 9.13 EMAC ............................................................................................................................................................. 1268 9.13.1 Overview ........................................................................................................................................... 1268 9.13.2 Block Diagram ................................................................................................................................... 1268 9.13.3 Functional Description ...................................................................................................................... 1269 9.13.4 Programming Guidelines ................................................................................................................... 1276 9.13.5 Register List ....................................................................................................................................... 1277 9.13.6 Register Description .......................................................................................................................... 1278 9.14 CIR Receiver .................................................................................................................................................. 1296 9.14.1 Overview ........................................................................................................................................... 1296 9.14.2 Block Diagram ................................................................................................................................... 1296 9.14.3 Functional Description ...................................................................................................................... 1297 9.14.4 Programming Guidelines ................................................................................................................... 1301 9.14.5 Register List ....................................................................................................................................... 1302 9.14.6 Register Description .......................................................................................................................... 1302 9.15 CIR Transmitter ............................................................................................................................................. 1308 9.15.1 Overview ........................................................................................................................................... 1308 9.15.2 Block Diagram ................................................................................................................................... 1308 9.15.3 Functional Description ...................................................................................................................... 1309 9.15.4 Programming Guidelines ................................................................................................................... 1311 9.15.5 Register List ....................................................................................................................................... 1312 9.15.6 Register Description .......................................................................................................................... 1312 Figure 9-1 TWI Block Diagram ........................................................................................................................................... 838 Figure 9-2 Write Timing in 7-bit Standard Addressing Mode ........................................................................................... 840 Figure 9-3 Read Timing in 7-bit Standard Addressing Mode ............................................................................................ 840 Figure 9-4 Write Timing in 10-bit Extended Addressing Mode ......................................................................................... 841 Figure 9-5 Read Timing in 10-bit Extended Addressing Mode .......................................................................................... 841 Figure 9-6 TWI Driver Write Packet Transmission ............................................................................................................ 842 Figure 9-7 TWI Driver Read Packet Transmission ............................................................................................................. 843 Figure 9-8 TWI Programming State Diagram .................................................................................................................... 845 Figure 9-9 UART Block Diagram ........................................................................................................................................ 865 Figure 9-10 UART Serial Data Format ............................................................................................................................... 866 Figure 9-11 Application Diagram for RTS/CTS Autoflow Control ...................................................................................... 867 Figure 9-12 RTS/CTS Autoflow Control Data Format ........................................................................................................ 867 Figure 9-13 Application Diagram for IrDA Transceiver ..................................................................................................... 867 Figure 9-14 Serial IrDA Data Format ................................................................................................................................. 867 Figure 9-15 Application Diagram for RS-485 Transceiver ................................................................................................. 868 Figure 9-16 RS-485 Data Format ....................................................................................................................................... 868 Figure 9-17 UART Mode Baud and Error Rates ................................................................................................................. 869 Figure 9-18 IrDA Mode Baud and Error Rates ................................................................................................................... 870 Figure 9-19 RS485 Mode Baud and Error Rates ................................................................................................................ 870 Figure 9-20 SPI Block Diagram .......................................................................................................................................... 906 Figure 9-21 SPI Application Block Diagram ....................................................................................................................... 908 Figure 9-22 SPI Phase 0 Timing Diagram ........................................................................................................................... 909 Figure 9-23 SPI Phase 1 Timing Diagram ........................................................................................................................... 909 Figure 9-24 SPI 3-Wire Mode ............................................................................................................................................ 910 Figure 9-25 SPI Dual-Input/Dual-Output Mode ................................................................................................................ 911 Figure 9-26 SPI Dual I/O Mode .......................................................................................................................................... 911 Figure 9-27 SPI Quad-Input/Quad-Output Mode ............................................................................................................. 912 Figure 9-28 SPI Write/Read Data in CPU Mode ................................................................................................................ 916 Figure 9-29 SPI Write/Read Data in DMA Mode ............................................................................................................... 917 Figure 9-30 SPI_DBI Block Diagram ................................................................................................................................... 941 Figure 9-31 SPI Application Block Diagram ....................................................................................................................... 944 Figure 9-32 DBI Application Block Diagram ...................................................................................................................... 944 Figure 9-33 SPI Phase 0 Timing Diagram ........................................................................................................................... 945 Figure 9-34 SPI Phase 1 Timing Diagram ........................................................................................................................... 945 Figure 9-35 SPI 3-Wire Mode ............................................................................................................................................ 946 Figure 9-36 SPI Dual-Input/Dual-Output Mode ................................................................................................................ 947 Figure 9-37 SPI Dual I/O Mode .......................................................................................................................................... 947 Figure 9-38 SPI Quad-Input/Quad-Output Mode ............................................................................................................. 948 Figure 9-39 DBI 3-Line Display Bus Serial Interface Writing Operation Format ............................................................... 950 Figure 9-40 DBI 3-Line Display Bus Serial Interface 8-bit Reading Operation Format ...................................................... 951 Figure 9-41 DBI 3-Line Display Bus Serial Interface 24-bit Reading Operation Format .................................................... 951 Figure 9-42 DBI 3-Line Display Bus Serial Interface 32-bit Reading Operation Format .................................................... 952 Figure 9-43 DBI 4-Line Display Bus Serial Interface Writing Operation Format ............................................................... 953 Figure 9-44 DBI 4-Line Display Bus Serial Interface 8-bit Reading Operation Format ...................................................... 953 Figure 9-45 DBI 4-Line Display Bus Serial Interface 24-bit Reading Operation Format .................................................... 954 Figure 9-46 DBI 4-Line Display Bus Serial Interface 32-bit Reading Operation Format .................................................... 954 Figure 9-47 RGB111 3-Line Interface Transmit Video Format .......................................................................................... 955 Figure 9-48 RGB444 3-Line Interface Transmit Video Format .......................................................................................... 955 Figure 9-49 RGB565 3-Line Interface Transmit Video Format .......................................................................................... 956 Figure 9-50 RGB666 3-Line Interface Transmit Video Format .......................................................................................... 956 Figure 9-51 RGB111 4-Line Interface Transmit Video Format .......................................................................................... 957 Figure 9-52 RGB444 4-Line Interface Transmit Video Format .......................................................................................... 957 Figure 9-53 RGB565 4-Line Interface Transmit Video Format .......................................................................................... 958 Figure 9-54 RGB666 4-Line Interface Transmit Video Format .......................................................................................... 958 Figure 9-55 RGB444 2 Data Lane Interface Transmit Video Format ................................................................................. 959 Figure 9-56 RGB565 2 Data Lane Interface Transmit Video Format ................................................................................. 960 Figure 9-57 RGB666 2 Data Lane Interface Transmit Video Format 0 .............................................................................. 961 Figure 9-58 RGB666 2 Data Lane Interface Transmit Video Format 1 (ilitek) ................................................................... 961 Figure 9-59 RGB666 2 Data Lane Interface Transmit Video Format 2 (New vision) ......................................................... 961 Figure 9-60 RGB888 2 Data Lane Interface Transmit Video Format ................................................................................. 962 Figure 9-61 SPI Write/Read Data in CPU Mode ................................................................................................................ 963 Figure 9-62 SPI Write/Read Data in DMA Mode ............................................................................................................... 964 Figure 9-63 USB2.0 DRD Controller Block Diagram ........................................................................................................ 1004 Figure 9-64 USB2.0 DRD Controller and PHY Connection Diagram ................................................................................ 1005 Figure 9-65 USB2.0 Host Controller Block Diagram ........................................................................................................ 1006 Figure 9-66 USB2.0 Host Controller and PHY Connection Diagram ................................................................................ 1007 Figure 9-67 GPIO Block Diagram ..................................................................................................................................... 1049 Figure 9-68 Pull up/down Logic ...................................................................................................................................... 1055 Figure 9-69 IO Buffer Strength Diagram ......................................................................................................................... 1056 Figure 9-70 GPADC Block Diagram .................................................................................................................................. 1168 Figure 9-71 GPADC Clock and Timing Requirement ....................................................................................................... 1170 Figure 9-72 GPADC Initial Process ................................................................................................................................... 1171 Figure 9-73 TPADC Single-Ended Mode for AUX ADC ..................................................................................................... 1183 Figure 9-74 TPADC Differential Mode for Touch Panel................................................................................................... 1184 Figure 9-75 Single Touch X-Coordinate Measurement for Touch Panel ......................................................................... 1184 Figure 9-76 Dual Touch Detection for Touch Panel ........................................................................................................ 1185 Figure 9-77 Touch Pressure Measurement for Touch Panel .......................................................................................... 1186 Figure 9-78 Pen Down Detection for Touch Panel .......................................................................................................... 1187 Figure 9-79 Median and Averaging Filter Size ................................................................................................................ 1187 Figure 9-80 Median and Averaging Filter Example ......................................................................................................... 1188 Figure 9-81 LRADC Block Diagram .................................................................................................................................. 1197 Figure 9-82 LRADC Interrupt ........................................................................................................................................... 1199 Figure 9-83 PWM Block Diagram .................................................................................................................................... 1207 Figure 9-84 PWM01 Clock Controller Diagram ............................................................................................................... 1208 Figure 9-85 PWM01 Output Logic Module Diagram ....................................................................................................... 1209 Figure 9-86 PWM0 High Level Active State ..................................................................................................................... 1210 Figure 9-87 PWM0 Low Level Active State ..................................................................................................................... 1211 Figure 9-88 Phase of PWM0 High Level Active State ...................................................................................................... 1211 Figure 9-89 PWM0 Output Waveform in Pulse Mode and Cycle Mode ......................................................................... 1212 Figure 9-90 PWM01 Complementary Pair Output .......................................................................................................... 1213 Figure 9-91 Dead-time Output Waveform ...................................................................................................................... 1213 Figure 9-92 Group 0~3 PWM Signal Output ................................................................................................................... 1214 Figure 9-93 PWM01 Capture Logic Module Diagram ..................................................................................................... 1215 Figure 9-94 PWM0 Channel Capture Timing................................................................................................................... 1216 Figure 9-95 LEDC Block Diagram ..................................................................................................................................... 1247 Figure 9-96 LEDC Package Output Timing Diagram ........................................................................................................ 1248 Figure 9-97 LEDC 1-frame Output Timing Diagram......................................................................................................... 1249 Figure 9-98 LEDC Input Data Structure ........................................................................................................................... 1249 Figure 9-99 LEDC Typical Circuit ...................................................................................................................................... 1249 Figure 9-100 LEDC Data Input Code ................................................................................................................................ 1250 Figure 9-101 LEDC Data Transfer Mode .......................................................................................................................... 1250 Figure 9-102 LEDC Normal Configuration Process .......................................................................................................... 1253 Figure 9-103 LEDC Timeout Abnormal Processing Flow ................................................................................................. 1255 Figure 9-104 FIFO Overflow Abnormal Processing Flow ................................................................................................. 1256 Figure 9-105 EMAC Block Diagram ................................................................................................................................. 1269 Figure 9-106 EMAC Typical Application .......................................................................................................................... 1271 Figure 9-107 EMAC RX/TX Descriptor List ....................................................................................................................... 1272 Figure 9-108 CIR_RX Block Diagram ................................................................................................................................ 1296 Figure 9-109 CIR_RX Clock System .................................................................................................................................. 1297 Figure 9-110 CIR_RX Application Diagram ...................................................................................................................... 1297 Figure 9-111 NEC Protocol .............................................................................................................................................. 1298 Figure 9-112 Logical ‘0’ and Logical ‘1’ of NEC Protocol ................................................................................................. 1298 Figure 9-113 ATHR Definition ......................................................................................................................................... 1299 Figure 9-114 ITHR Definition ........................................................................................................................................... 1299 Figure 9-115 NTHR Definition ......................................................................................................................................... 1299 Figure 9-116 APAM Definition ........................................................................................................................................ 1300 Figure 9-117 CIR Receiver Process .................................................................................................................................. 1301 Figure 9-118 CIR_TX Block Diagram ................................................................................................................................ 1308 Figure 9-119 CIR_TX Clock Description ........................................................................................................................... 1309 Figure 9-120 Definitions of Logical “1” and Logical “0” .................................................................................................. 1310 Figure 9-121 CIR Message Timing Diagram..................................................................................................................... 1310 Figure 9-122 CIR Transmitter Process ............................................................................................................................. 1311 Table 9-1 TWI Sub-blocks .................................................................................................................................................. 838 Table 9-2 TWI External Signals .......................................................................................................................................... 839 Table 9-3 TWI Clock Sources ............................................................................................................................................. 839 Table 9-4 UART External Signals ....................................................................................................................................... 865 Table 9-5 UART Clock Sources........................................................................................................................................... 866 Table 9-6 SPI Sub-blocks ................................................................................................................................................... 906 Table 9-7 SPI External Signals ........................................................................................................................................... 907 Table 9-8 SPI Clock Sources ............................................................................................................................................... 907 Table 9-9 SPI Transmit Format .......................................................................................................................................... 909 Table 9-10 SPI Old Sample Mode and Run Clock .............................................................................................................. 913 Table 9-11 SPI New Sample Mode .................................................................................................................................... 913 Table 9-12 SPI_DBI Sub-blocks .......................................................................................................................................... 941 Table 9-13 SPI_DBI External Signals .................................................................................................................................. 942 Table 9-14 SPI_DBI Clock Sources ..................................................................................................................................... 943 Table 9-15 SPI Transmit Format ........................................................................................................................................ 945 Table 9-16 SPI Old Sample Mode and Run Clock .............................................................................................................. 949 Table 9-17 SPI New Sample Mode .................................................................................................................................... 949 Table 9-18 USB2.0 DRD External Signals ......................................................................................................................... 1004 Table 9-19 USB2.0 Host External Signals ........................................................................................................................ 1007 Table 9-20 Multi-function Port ....................................................................................................................................... 1049 Table 9-21 PB Multiplex Function ................................................................................................................................... 1051 Table 9-22 PC Multiplex Function ................................................................................................................................... 1051 Table 9-23 PD Multiplex Function ................................................................................................................................... 1052 Table 9-24 PE Multiplex Function ................................................................................................................................... 1052 Table 9-25 PF Multiplex Function ................................................................................................................................... 1053 Table 9-26 PG Multiplex Function ................................................................................................................................... 1053 Table 9-27 Port Function ................................................................................................................................................. 1055 Table 9-28 GPADC External Signals ................................................................................................................................. 1169 Table 9-29 GPADC Clock Sources .................................................................................................................................... 1169 Table 9-30 TPADC External Signals.................................................................................................................................. 1182 Table 9-31 LRADC External Signals .................................................................................................................................. 1198 Table 9-32 LRADC Clock Sources ..................................................................................................................................... 1198 Table 9-33 PWM External Signals ................................................................................................................................... 1207 Table 9-34 LEDC Sub-blocks ............................................................................................................................................ 1247 Table 9-35 LEDC External Signals .................................................................................................................................... 1248 Table 9-36 LEDC Clock Sources ....................................................................................................................................... 1248 Table 9-37 Time Parameters of Typical LED Specification .............................................................................................. 1250 Table 9-38 EMAC Pin Mapping........................................................................................................................................ 1269 Table 9-39 EMAC RGMII Pin List ..................................................................................................................................... 1270 Table 9-40 EMAC RMII Pin List ........................................................................................................................................ 1270 Table 9-41 EMAC Clock Characteristics ........................................................................................................................... 1271 Table 9-42 EMAC_EPHY_CLK_REG0 Configuration Value ............................................................................................... 1276 Table 9-43 CIR_RX External Signals ................................................................................................................................. 1297 Table 9-44 CIR_TX External Signals ................................................................................................................................. 1309
    3=_40I (40I I=7 uA 9 Interfaces ................................................................................................................................................................ 837 9.1 TWI .................................................................................................................................................................. 837 9.1.1 Overview ............................................................................................................................................. 837 9.1.2 Block Diagram ..................................................................................................................................... 837 9.1.3 Functional Description ........................................................................................................................ 839 9.1.4 Programming Guidelines ..................................................................................................................... 845 9.1.5 Register List ......................................................................................................................................... 848 9.1.6 Register Description ............................................................................................................................ 849 9.2 UART................................................................................................................................................................ 864 9.2.1 Overview ............................................................................................................................................. 864 9.2.2 Block Diagram ..................................................................................................................................... 864 9.2.3 Functional Description ........................................................................................................................ 865 9.2.4 Programming Guidelines ..................................................................................................................... 871 9.2.5 Register List ......................................................................................................................................... 874 9.2.6 Register Description ............................................................................................................................ 876 9.3 SPI .................................................................................................................................................................... 905 9.3.1 Overview ............................................................................................................................................. 905 9.3.2 Block Diagram ..................................................................................................................................... 905 9.3.3 Functional Description ........................................................................................................................ 907 9.3.4 Programming Guidelines ..................................................................................................................... 915 9.3.5 Register List ......................................................................................................................................... 918 9.3.6 Register Description ............................................................................................................................ 919 9.4 SPI_DBI ............................................................................................................................................................ 940 9.4.1 Overview ............................................................................................................................................. 940 9.4.2 Block Diagram ..................................................................................................................................... 941 9.4.3 Functional Description ........................................................................................................................ 942 9.4.4 Programming Guidelines ..................................................................................................................... 962 9.4.5 Register List ......................................................................................................................................... 970 9.4.6 Register Description ............................................................................................................................ 971 9.5 USB2.0 DRD ................................................................................................................................................... 1003 9.5.1 Overview ........................................................................................................................................... 1003 9.5.2 Block Diagram ................................................................................................................................... 1004 9.5.3 Functional Description ...................................................................................................................... 1004 9.6 USB2.0 HOST ................................................................................................................................................. 1006 9.6.1 Overview ........................................................................................................................................... 1006 9.6.2 Block Diagram ................................................................................................................................... 1006 9.6.3 Functional Description ...................................................................................................................... 1007 9.6.4 Register List ....................................................................................................................................... 1007 9.6.5 EHCI Register Description.................................................................................................................. 1009 9.6.6 OHCI Register Description ................................................................................................................. 1026 9.7 GPIO .............................................................................................................................................................. 1048 9.7.1 Overview ........................................................................................................................................... 1048 9.7.2 Block Diagram ................................................................................................................................... 1048 9.7.3 Functional Description ...................................................................................................................... 1049 9.7.4 Register List ....................................................................................................................................... 1058 9.7.5 Register Description .......................................................................................................................... 1060 9.8 GPADC ........................................................................................................................................................... 1168 9.8.1 Overview ........................................................................................................................................... 1168 9.8.2 Block Diagram ................................................................................................................................... 1168 9.8.3 Functional Description ...................................................................................................................... 1169 9.8.4 Programming Guidelines ................................................................................................................... 1170 9.8.5 Register List ....................................................................................................................................... 1172 9.8.6 Register Description .......................................................................................................................... 1173 9.9 TPADC ............................................................................................................................................................ 1182 9.9.1 Overview ........................................................................................................................................... 1182 9.9.2 Functional Description ...................................................................................................................... 1182 9.9.3 Register List ....................................................................................................................................... 1188 9.9.4 Register Description .......................................................................................................................... 1189 9.10 LRADC ............................................................................................................................................................ 1197 9.10.1 Overview ........................................................................................................................................... 1197 9.10.2 Block Diagram ................................................................................................................................... 1197 9.10.3 Functional Description ...................................................................................................................... 1198 9.10.4 Programming Guidelines ................................................................................................................... 1199 9.10.5 Register List ....................................................................................................................................... 1201 9.10.6 Register Description .......................................................................................................................... 1201 9.11 PWM ............................................................................................................................................................. 1206 9.11.1 Overview ........................................................................................................................................... 1206 9.11.2 Block Diagram ................................................................................................................................... 1206 9.11.3 Functional Description ...................................................................................................................... 1207 9.11.4 Programming Guidelines ................................................................................................................... 1217 9.11.5 Register List ....................................................................................................................................... 1218 9.11.6 Register Description .......................................................................................................................... 1220 9.12 LEDC .............................................................................................................................................................. 1247 9.12.1 Overview ........................................................................................................................................... 1247 9.12.2 Block Diagram ................................................................................................................................... 1247 9.12.3 Functional Description ...................................................................................................................... 1248 9.12.4 Programming Guidelines ................................................................................................................... 1252 9.12.5 Register List ....................................................................................................................................... 1257 9.12.6 Register Description .......................................................................................................................... 1257 9.13 EMAC ............................................................................................................................................................. 1268 9.13.1 Overview ........................................................................................................................................... 1268 9.13.2 Block Diagram ................................................................................................................................... 1268 9.13.3 Functional Description ...................................................................................................................... 1269 9.13.4 Programming Guidelines ................................................................................................................... 1276 9.13.5 Register List ....................................................................................................................................... 1277 9.13.6 Register Description .......................................................................................................................... 1278 9.14 CIR Receiver .................................................................................................................................................. 1296 9.14.1 Overview ........................................................................................................................................... 1296 9.14.2 Block Diagram ................................................................................................................................... 1296 9.14.3 Functional Description ...................................................................................................................... 1297 9.14.4 Programming Guidelines ................................................................................................................... 1301 9.14.5 Register List ....................................................................................................................................... 1302 9.14.6 Register Description .......................................................................................................................... 1302 9.15 CIR Transmitter ............................................................................................................................................. 1308 9.15.1 Overview ........................................................................................................................................... 1308 9.15.2 Block Diagram ................................................................................................................................... 1308 9.15.3 Functional Description ...................................................................................................................... 1309 9.15.4 Programming Guidelines ................................................................................................................... 1311 9.15.5 Register List ....................................................................................................................................... 1312 9.15.6 Register Description .......................................................................................................................... 1312 Figure 9-1 TWI Block Diagram ........................................................................................................................................... 838 Figure 9-2 Write Timing in 7-bit Standard Addressing Mode ........................................................................................... 840 Figure 9-3 Read Timing in 7-bit Standard Addressing Mode ............................................................................................ 840 Figure 9-4 Write Timing in 10-bit Extended Addressing Mode ......................................................................................... 841 Figure 9-5 Read Timing in 10-bit Extended Addressing Mode .......................................................................................... 841 Figure 9-6 TWI Driver Write Packet Transmission ............................................................................................................ 842 Figure 9-7 TWI Driver Read Packet Transmission ............................................................................................................. 843 Figure 9-8 TWI Programming State Diagram .................................................................................................................... 845 Figure 9-9 UART Block Diagram ........................................................................................................................................ 865 Figure 9-10 UART Serial Data Format ............................................................................................................................... 866 Figure 9-11 Application Diagram for RTS/CTS Autoflow Control ...................................................................................... 867 Figure 9-12 RTS/CTS Autoflow Control Data Format ........................................................................................................ 867 Figure 9-13 Application Diagram for IrDA Transceiver ..................................................................................................... 867 Figure 9-14 Serial IrDA Data Format ................................................................................................................................. 867 Figure 9-15 Application Diagram for RS-485 Transceiver ................................................................................................. 868 Figure 9-16 RS-485 Data Format ....................................................................................................................................... 868 Figure 9-17 UART Mode Baud and Error Rates ................................................................................................................. 869 Figure 9-18 IrDA Mode Baud and Error Rates ................................................................................................................... 870 Figure 9-19 RS485 Mode Baud and Error Rates ................................................................................................................ 870 Figure 9-20 SPI Block Diagram .......................................................................................................................................... 906 Figure 9-21 SPI Application Block Diagram ....................................................................................................................... 908 Figure 9-22 SPI Phase 0 Timing Diagram ........................................................................................................................... 909 Figure 9-23 SPI Phase 1 Timing Diagram ........................................................................................................................... 909 Figure 9-24 SPI 3-Wire Mode ............................................................................................................................................ 910 Figure 9-25 SPI Dual-Input/Dual-Output Mode ................................................................................................................ 911 Figure 9-26 SPI Dual I/O Mode .......................................................................................................................................... 911 Figure 9-27 SPI Quad-Input/Quad-Output Mode ............................................................................................................. 912 Figure 9-28 SPI Write/Read Data in CPU Mode ................................................................................................................ 916 Figure 9-29 SPI Write/Read Data in DMA Mode ............................................................................................................... 917 Figure 9-30 SPI_DBI Block Diagram ................................................................................................................................... 941 Figure 9-31 SPI Application Block Diagram ....................................................................................................................... 944 Figure 9-32 DBI Application Block Diagram ...................................................................................................................... 944 Figure 9-33 SPI Phase 0 Timing Diagram ........................................................................................................................... 945 Figure 9-34 SPI Phase 1 Timing Diagram ........................................................................................................................... 945 Figure 9-35 SPI 3-Wire Mode ............................................................................................................................................ 946 Figure 9-36 SPI Dual-Input/Dual-Output Mode ................................................................................................................ 947 Figure 9-37 SPI Dual I/O Mode .......................................................................................................................................... 947 Figure 9-38 SPI Quad-Input/Quad-Output Mode ............................................................................................................. 948 Figure 9-39 DBI 3-Line Display Bus Serial Interface Writing Operation Format ............................................................... 950 Figure 9-40 DBI 3-Line Display Bus Serial Interface 8-bit Reading Operation Format ...................................................... 951 Figure 9-41 DBI 3-Line Display Bus Serial Interface 24-bit Reading Operation Format .................................................... 951 Figure 9-42 DBI 3-Line Display Bus Serial Interface 32-bit Reading Operation Format .................................................... 952 Figure 9-43 DBI 4-Line Display Bus Serial Interface Writing Operation Format ............................................................... 953 Figure 9-44 DBI 4-Line Display Bus Serial Interface 8-bit Reading Operation Format ...................................................... 953 Figure 9-45 DBI 4-Line Display Bus Serial Interface 24-bit Reading Operation Format .................................................... 954 Figure 9-46 DBI 4-Line Display Bus Serial Interface 32-bit Reading Operation Format .................................................... 954 Figure 9-47 RGB111 3-Line Interface Transmit Video Format .......................................................................................... 955 Figure 9-48 RGB444 3-Line Interface Transmit Video Format .......................................................................................... 955 Figure 9-49 RGB565 3-Line Interface Transmit Video Format .......................................................................................... 956 Figure 9-50 RGB666 3-Line Interface Transmit Video Format .......................................................................................... 956 Figure 9-51 RGB111 4-Line Interface Transmit Video Format .......................................................................................... 957 Figure 9-52 RGB444 4-Line Interface Transmit Video Format .......................................................................................... 957 Figure 9-53 RGB565 4-Line Interface Transmit Video Format .......................................................................................... 958 Figure 9-54 RGB666 4-Line Interface Transmit Video Format .......................................................................................... 958 Figure 9-55 RGB444 2 Data Lane Interface Transmit Video Format ................................................................................. 959 Figure 9-56 RGB565 2 Data Lane Interface Transmit Video Format ................................................................................. 960 Figure 9-57 RGB666 2 Data Lane Interface Transmit Video Format 0 .............................................................................. 961 Figure 9-58 RGB666 2 Data Lane Interface Transmit Video Format 1 (ilitek) ................................................................... 961 Figure 9-59 RGB666 2 Data Lane Interface Transmit Video Format 2 (New vision) ......................................................... 961 Figure 9-60 RGB888 2 Data Lane Interface Transmit Video Format ................................................................................. 962 Figure 9-61 SPI Write/Read Data in CPU Mode ................................................................................................................ 963 Figure 9-62 SPI Write/Read Data in DMA Mode ............................................................................................................... 964 Figure 9-63 USB2.0 DRD Controller Block Diagram ........................................................................................................ 1004 Figure 9-64 USB2.0 DRD Controller and PHY Connection Diagram ................................................................................ 1005 Figure 9-65 USB2.0 Host Controller Block Diagram ........................................................................................................ 1006 Figure 9-66 USB2.0 Host Controller and PHY Connection Diagram ................................................................................ 1007 Figure 9-67 GPIO Block Diagram ..................................................................................................................................... 1049 Figure 9-68 Pull up/down Logic ...................................................................................................................................... 1055 Figure 9-69 IO Buffer Strength Diagram ......................................................................................................................... 1056 Figure 9-70 GPADC Block Diagram .................................................................................................................................. 1168 Figure 9-71 GPADC Clock and Timing Requirement ....................................................................................................... 1170 Figure 9-72 GPADC Initial Process ................................................................................................................................... 1171 Figure 9-73 TPADC Single-Ended Mode for AUX ADC ..................................................................................................... 1183 Figure 9-74 TPADC Differential Mode for Touch Panel................................................................................................... 1184 Figure 9-75 Single Touch X-Coordinate Measurement for Touch Panel ......................................................................... 1184 Figure 9-76 Dual Touch Detection for Touch Panel ........................................................................................................ 1185 Figure 9-77 Touch Pressure Measurement for Touch Panel .......................................................................................... 1186 Figure 9-78 Pen Down Detection for Touch Panel .......................................................................................................... 1187 Figure 9-79 Median and Averaging Filter Size ................................................................................................................ 1187 Figure 9-80 Median and Averaging Filter Example ......................................................................................................... 1188 Figure 9-81 LRADC Block Diagram .................................................................................................................................. 1197 Figure 9-82 LRADC Interrupt ........................................................................................................................................... 1199 Figure 9-83 PWM Block Diagram .................................................................................................................................... 1207 Figure 9-84 PWM01 Clock Controller Diagram ............................................................................................................... 1208 Figure 9-85 PWM01 Output Logic Module Diagram ....................................................................................................... 1209 Figure 9-86 PWM0 High Level Active State ..................................................................................................................... 1210 Figure 9-87 PWM0 Low Level Active State ..................................................................................................................... 1211 Figure 9-88 Phase of PWM0 High Level Active State ...................................................................................................... 1211 Figure 9-89 PWM0 Output Waveform in Pulse Mode and Cycle Mode ......................................................................... 1212 Figure 9-90 PWM01 Complementary Pair Output .......................................................................................................... 1213 Figure 9-91 Dead-time Output Waveform ...................................................................................................................... 1213 Figure 9-92 Group 0~3 PWM Signal Output ................................................................................................................... 1214 Figure 9-93 PWM01 Capture Logic Module Diagram ..................................................................................................... 1215 Figure 9-94 PWM0 Channel Capture Timing................................................................................................................... 1216 Figure 9-95 LEDC Block Diagram ..................................................................................................................................... 1247 Figure 9-96 LEDC Package Output Timing Diagram ........................................................................................................ 1248 Figure 9-97 LEDC 1-frame Output Timing Diagram......................................................................................................... 1249 Figure 9-98 LEDC Input Data Structure ........................................................................................................................... 1249 Figure 9-99 LEDC Typical Circuit ...................................................................................................................................... 1249 Figure 9-100 LEDC Data Input Code ................................................................................................................................ 1250 Figure 9-101 LEDC Data Transfer Mode .......................................................................................................................... 1250 Figure 9-102 LEDC Normal Configuration Process .......................................................................................................... 1253 Figure 9-103 LEDC Timeout Abnormal Processing Flow ................................................................................................. 1255 Figure 9-104 FIFO Overflow Abnormal Processing Flow ................................................................................................. 1256 Figure 9-105 EMAC Block Diagram ................................................................................................................................. 1269 Figure 9-106 EMAC Typical Application .......................................................................................................................... 1271 Figure 9-107 EMAC RX/TX Descriptor List ....................................................................................................................... 1272 Figure 9-108 CIR_RX Block Diagram ................................................................................................................................ 1296 Figure 9-109 CIR_RX Clock System .................................................................................................................................. 1297 Figure 9-110 CIR_RX Application Diagram ...................................................................................................................... 1297 Figure 9-111 NEC Protocol .............................................................................................................................................. 1298 Figure 9-112 Logical ‘0’ and Logical ‘1’ of NEC Protocol ................................................................................................. 1298 Figure 9-113 ATHR Definition ......................................................................................................................................... 1299 Figure 9-114 ITHR Definition ........................................................................................................................................... 1299 Figure 9-115 NTHR Definition ......................................................................................................................................... 1299 Figure 9-116 APAM Definition ........................................................................................................................................ 1300 Figure 9-117 CIR Receiver Process .................................................................................................................................. 1301 Figure 9-118 CIR_TX Block Diagram ................................................................................................................................ 1308 Figure 9-119 CIR_TX Clock Description ........................................................................................................................... 1309 Figure 9-120 Definitions of Logical “1” and Logical “0” .................................................................................................. 1310 Figure 9-121 CIR Message Timing Diagram..................................................................................................................... 1310 Figure 9-122 CIR Transmitter Process ............................................................................................................................. 1311 Table 9-1 TWI Sub-blocks .................................................................................................................................................. 838 Table 9-2 TWI External Signals .......................................................................................................................................... 839 Table 9-3 TWI Clock Sources ............................................................................................................................................. 839 Table 9-4 UART External Signals ....................................................................................................................................... 865 Table 9-5 UART Clock Sources........................................................................................................................................... 866 Table 9-6 SPI Sub-blocks ................................................................................................................................................... 906 Table 9-7 SPI External Signals ........................................................................................................................................... 907 Table 9-8 SPI Clock Sources ............................................................................................................................................... 907 Table 9-9 SPI Transmit Format .......................................................................................................................................... 909 Table 9-10 SPI Old Sample Mode and Run Clock .............................................................................................................. 913 Table 9-11 SPI New Sample Mode .................................................................................................................................... 913 Table 9-12 SPI_DBI Sub-blocks .......................................................................................................................................... 941 Table 9-13 SPI_DBI External Signals .................................................................................................................................. 942 Table 9-14 SPI_DBI Clock Sources ..................................................................................................................................... 943 Table 9-15 SPI Transmit Format ........................................................................................................................................ 945 Table 9-16 SPI Old Sample Mode and Run Clock .............................................................................................................. 949 Table 9-17 SPI New Sample Mode .................................................................................................................................... 949 Table 9-18 USB2.0 DRD External Signals ......................................................................................................................... 1004 Table 9-19 USB2.0 Host External Signals ........................................................................................................................ 1007 Table 9-20 Multi-function Port ....................................................................................................................................... 1049 Table 9-21 PB Multiplex Function ................................................................................................................................... 1051 Table 9-22 PC Multiplex Function ................................................................................................................................... 1051 Table 9-23 PD Multiplex Function ................................................................................................................................... 1052 Table 9-24 PE Multiplex Function ................................................................................................................................... 1052 Table 9-25 PF Multiplex Function ................................................................................................................................... 1053 Table 9-26 PG Multiplex Function ................................................................................................................................... 1053 Table 9-27 Port Function ................................................................................................................................................. 1055 Table 9-28 GPADC External Signals ................................................................................................................................. 1169 Table 9-29 GPADC Clock Sources .................................................................................................................................... 1169 Table 9-30 TPADC External Signals.................................................................................................................................. 1182 Table 9-31 LRADC External Signals .................................................................................................................................. 1198 Table 9-32 LRADC Clock Sources ..................................................................................................................................... 1198 Table 9-33 PWM External Signals ................................................................................................................................... 1207 Table 9-34 LEDC Sub-blocks ............................................................................................................................................ 1247 Table 9-35 LEDC External Signals .................................................................................................................................... 1248 Table 9-36 LEDC Clock Sources ....................................................................................................................................... 1248 Table 9-37 Time Parameters of Typical LED Specification .............................................................................................. 1250 Table 9-38 EMAC Pin Mapping........................................................................................................................................ 1269 Table 9-39 EMAC RGMII Pin List ..................................................................................................................................... 1270 Table 9-40 EMAC RMII Pin List ........................................................................................................................................ 1270 Table 9-41 EMAC Clock Characteristics ........................................................................................................................... 1271 Table 9-42 EMAC_EPHY_CLK_REG0 Configuration Value ............................................................................................... 1276 Table 9-43 CIR_RX External Signals ................................................................................................................................. 1297 Table 9-44 CIR_TX External Signals ................................................................................................................................. 1309)
